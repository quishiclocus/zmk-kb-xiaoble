## boards/shields/bleboard/Kconfig.defconfig
```kconfig
if SHIELD_BLEBOARD

# Name must be less than 16 characters long!
config ZMK_KEYBOARD_NAME
    default "BLEboard"

endif
```

## boards/shields/bleboard/Kconfig.shield
```kconfig
# No whitespace after the comma or in your keyboard name!
config SHIELD_BLEBOARD
    def_bool $(shields_list_contains,bleboard)
```

## config/west.yml
```yaml
manifest:
  remotes:
    - name: zmkfirmware
      url-base: https://github.com/zmkfirmware
    - name: zmk-kb-xiaoble
      url-base: http://github.com/quishiclocus
    # Additional modules containing boards/shields/custom code can be listed here as well
    # See https://docs.zephyrproject.org/3.2.0/develop/west/manifest.html#projects
  projects:
    - name: zmk
      remote: zmkfirmware
      revision: main
      import: app/west.yml
    - name: bleboard
      remote: zmk-kb-xiaoble
      revision: main
      import: west.yml
  self:
    path: config
```
